## firmware/sdkconfig.defaults
```kconfig
# Enable support for power management
CONFIG_PM_ENABLE=y
# Enable tickless idle mode
CONFIG_FREERTOS_USE_TICKLESS_IDLE=y
# Put related source code in IRAM
CONFIG_PM_SLP_IRAM_OPT=y
CONFIG_PM_RTOS_IDLE_OPT=y
# Use 1000Hz freertos tick to lower sleep time threshold
CONFIG_FREERTOS_HZ=1000
# For button power save
CONFIG_GPIO_BUTTON_SUPPORT_POWER_SAVE=y

#
# Bluetooth
#
CONFIG_BT_ENABLED=y
CONFIG_BT_BLUEDROID_ENABLED=y
CONFIG_BT_BLE_42_FEATURES_SUPPORTED=y

# Open Thread Configuration


#
# mbedTLS
#
CONFIG_MBEDTLS_CMAC_C=y
CONFIG_MBEDTLS_SSL_PROTO_DTLS=y
CONFIG_MBEDTLS_KEY_EXCHANGE_ECJPAKE=y
CONFIG_MBEDTLS_ECJPAKE_C=y
# end of mbedTLS

#
# IEEE 802.15.4
#
CONFIG_IEEE802154_ENABLED=y
CONFIG_IEEE802154_RECEIVE_DONE_HANDLER=y
# end of IEEE 802.15.4

########### WiFi Sniffer config ###########
# Reduce bootloader log verbosity
CONFIG_BOOTLOADER_LOG_LEVEL_WARN=y
CONFIG_BOOTLOADER_LOG_LEVEL=2

# Increase main task stack size
CONFIG_ESP_MAIN_TASK_STACK_SIZE=7168

# Enable FreeRTOS stats formatting functions, needed for 'tasks' command
CONFIG_FREERTOS_USE_TRACE_FACILITY=y
CONFIG_FREERTOS_USE_STATS_FORMATTING_FUNCTIONS=y

CONFIG_ESP_TASK_WDT_CHECK_IDLE_TASK_CPU0=n

#
# Serial flasher config
#
CONFIG_ESPTOOLPY_FLASHSIZE_4MB=y

# FatFS
CONFIG_FATFS_LFN_HEAP=y
CONFIG_FATFS_MAX_LFN=31

# Network Interfaces
CONFIG_EXAMPLE_USE_INTERNAL_ETHERNET=n
CONFIG_EXAMPLE_USE_SPI_ETHERNET=n

#
# Zboss
#
CONFIG_ZB_ENABLED=y
CONFIG_ZB_ZCZR=y
# end of Zboss
# end of Component config

#
# Log output
#
CONFIG_LOG_MASTER_LEVEL=y
# end of Log output

#
# ESP Console
#
CONFIG_ESP_CONSOLE_USB_SERIAL_JTAG=y
CONFIG_ESP_CONSOLE_USB_SERIAL_JTAG_ENABLED=y


#
# Enabled Features
#
## WIFI ##
CONFIG_WIFI_APPS_ENABLE=y
CONFIG_WIFI_APP_ANALYZER=y
CONFIG_WIFI_APP_DEAUTH=y
CONFIG_WIFI_APP_DOS=y
## BLUETOOTH ##
CONFIG_BLUETOOTH_APPS_ENABLE=y
CONFIG_BLUETOOTH_APP_TRAKERS=y
CONFIG_BLUETOOTH_APP_SPAM=y
CONFIG_BLUETOOTH_APP_HID=y
## ZIGBEE ##
CONFIG_ZIGBEE_APPS_ENABLE=y
CONFIG_ZIGBEE_APP_SPOOFING=y
CONFIG_ZIGBEE_APP_SNIFFER=y
## THREAD ##
CONFIG_THREAD_APPS_ENABLE=y
CONFIG_THREAD_APP_BROADCAST=y
CONFIG_THREAD_APP_SNIFFER=y
## GPS ##
CONFIG_GPS_APPS_ENABLE=n
CONFIG_GPS_APP_WARDRIVING=n
## OTA ##
CONFIG_OTA_ENABLE=n
## FILE MANAGER ##
CONFIG_FILE_MANAGER_ENABLE=y
CONFIG_FILE_MANAGER_LOCAL=y
CONFIG_FILE_MANAGER_WEB=y
## SD CARD ##
CONFIG_SD_CARD=n

#
# Partition Table
#
CONFIG_OPENTHREAD_ENABLED=y
CONFIG_PARTITION_TABLE_CUSTOM=y
CONFIG_PARTITION_TABLE_CUSTOM_FILENAME="partitions.csv"
CONFIG_PARTITION_TABLE_FILENAME="partitions.csv"
CONFIG_PARTITION_TABLE_OFFSET=0x8000
CONFIG_PARTITION_TABLE_MD5=y
# end of Partition Table

#
# Keyboard Configuration
#
CONFIG_BOOT_BUTTON=9
CONFIG_GPIO_LEFT_BUTTON=5
CONFIG_GPIO_RIGHT_BUTTON=10
CONFIG_GPIO_UP_BUTTON=0
CONFIG_GPIO_DOWN_BUTTON=1
# end of Keyboard Configuration

#
# OLED Screen Configuration
#
CONFIG_GPIO_RANGE_MAX=30
CONFIG_I2C_INTERFACE=y
# CONFIG_SPI_INTERFACE is not set
CONFIG_SSD1306=y
# CONFIG_SH1106 is not set
CONFIG_RESOLUTION_128X32=y
# CONFIG_RESOLUTION_128X64 is not set
# CONFIG_FLIP is not set
CONFIG_SCL_GPIO=7
CONFIG_SDA_GPIO=6
CONFIG_RESET_GPIO=-1
CONFIG_I2C_PORT_0=y
# end of OLED Screen Configuration

#
# Buzzer Configuration
#
# CONFIG_BUZZER_COMPONENT_ENABLED is not set
# end of Buzzer Configuration

#
# LEDs Configuration
#
# CONFIG_LEDS_COMPONENT_ENABLED is not set
# end of LEDs Configuration
```
